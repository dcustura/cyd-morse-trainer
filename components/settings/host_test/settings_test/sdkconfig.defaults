## main/Kconfig.projbuild
```kconfig
menu "Morse Trainer Hardware (ESP32-2432S028R / Cheap Yellow Display)"

    comment "Pin numbers below confirmed on real ESP32-2432S028R hardware; touch IRQ and TFT reset defaults were corrected during hardware bring-up (see git history)."

    config MORSE_TFT_MOSI_GPIO
        int "TFT MOSI GPIO"
        default 13

    config MORSE_TFT_MISO_GPIO
        int "TFT MISO GPIO"
        default 12

    config MORSE_TFT_SCLK_GPIO
        int "TFT SCLK GPIO"
        default 14

    config MORSE_TFT_CS_GPIO
        int "TFT CS GPIO"
        default 15

    config MORSE_TFT_DC_GPIO
        int "TFT DC (data/command) GPIO"
        default 2

    config MORSE_TFT_RST_GPIO
        int "TFT RST GPIO (-1 if not wired)"
        default 4
        help
            Confirmed on real hardware: this board wires TFT reset to
            GPIO4. Some other revisions may not wire a dedicated reset GPIO
            at all (the panel driver falls back to a software reset) - if
            the display fails to initialize on a different unit, try -1.

    config MORSE_TFT_BL_GPIO
        int "TFT backlight GPIO"
        default 21

    config MORSE_TOUCH_MOSI_GPIO
        int "Touch (XPT2046) MOSI GPIO"
        default 32

    config MORSE_TOUCH_MISO_GPIO
        int "Touch (XPT2046) MISO GPIO"
        default 39

    config MORSE_TOUCH_SCLK_GPIO
        int "Touch (XPT2046) SCLK GPIO"
        default 25

    config MORSE_TOUCH_CS_GPIO
        int "Touch (XPT2046) CS GPIO"
        default 33

    config MORSE_TOUCH_IRQ_GPIO
        int "Touch (XPT2046) IRQ GPIO (-1 to poll instead)"
        default -1
        help
            Confirmed on real hardware: leave this at -1 (polling). Setting
            a real GPIO here makes esp_lvgl_port switch to event-driven
            touch reads that only happen when that interrupt fires: if the
            IRQ line isn't behaving as expected, touch stops working
            entirely with no error. Polling is slightly less efficient but
            reliable.

    config MORSE_SPEAKER_GPIO
        int "Speaker / sidetone DAC GPIO"
        default 26
        help
            The sidetone is synthesized on the ESP32's built-in DAC, which
            only exists on two fixed pins: GPIO25 (DAC channel 0) or GPIO26
            (DAC channel 1). Changing this away from 26 also requires
            updating SIDETONE_DAC_CHANNEL_MASK in main/sidetone.c to match.

    config MORSE_PADDLE_DIT_GPIO
        int "Paddle DIT GPIO (also the straight-key input)"
        default 22

    config MORSE_PADDLE_DAH_GPIO
        int "Paddle DAH GPIO"
        default 27

endmenu
```
